/******************************************************************************
  *
  *   Copyright (C), 2010-2018, Beijing NiMotion Control Technology Co., Ltd.
  *
  *****************************************************************************
  *@file       : modbus.c
  *@version    : Initial Draft
  *@author     : Nimotion
  *@date       : 2022/8/16
  *@brief      :
  *****************************************************************************
  **function   :
								本程序为串口初始化配置文件
								需要用hal库重写
  *History     :
  *@date       : 2022/8/16
  *@author     : Nimotion
  *@note       : Created file

  ****************************************************************************/

#include "stm32f4xx.h"
#include "modbus.h"
#include "timer.h"
#include "string.h"
#include "stm32f4xx_usart.h"
#include "misc.h"
#include "main.h"

//接收缓存区 	
uint8_t RS485_RX_BUF[64]={0};  	//接收缓冲,最大64个字节.
//接收到的数据长度
uint8_t RS485_RX_CNT=0;   	
//接收完整数据标志
uint16_t RTU_FLAG=0;  
//CRC校验表
static const uint8_t aucCRCHi[] = {
    0x00, 0xC1, 0x81, 0x40, 0x01, 0xC0, 0x80, 0x41, 0x01, 0xC0, 0x80, 0x41,
    0x00, 0xC1, 0x81, 0x40, 0x01, 0xC0, 0x80, 0x41, 0x00, 0xC1, 0x81, 0x40,
    0x00, 0xC1, 0x81, 0x40, 0x01, 0xC0, 0x80, 0x41, 0x01, 0xC0, 0x80, 0x41,
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    0x00, 0xC1, 0x81, 0x40
};

static const uint8_t aucCRCLo[] = {
    0x00, 0xC0, 0xC1, 0x01, 0xC3, 0x03, 0x02, 0xC2, 0xC6, 0x06, 0x07, 0xC7,
    0x05, 0xC5, 0xC4, 0x04, 0xCC, 0x0C, 0x0D, 0xCD, 0x0F, 0xCF, 0xCE, 0x0E,
    0x0A, 0xCA, 0xCB, 0x0B, 0xC9, 0x09, 0x08, 0xC8, 0xD8, 0x18, 0x19, 0xD9,
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    0x41, 0x81, 0x80, 0x40
};
/********************************************************
  * @brief      : Modbus_Mode_Init
  * @details    : Modbus初始化
  * @param [in] : 
  * @param [out]: None
  * @retval     :
  * Calls       :
  * Called By   :

  * History
  * @date       : 2019/7/8
  * @author     : Nimotion
  *   @note     : Created function
  *
  ********************************************************/
static void NVIC_Configuration(void)
{
    NVIC_InitTypeDef NVIC_InitStructure;
    /* Configure the NVIC Preemption Priority Bits */
    NVIC_PriorityGroupConfig(NVIC_PriorityGroup_2);

    /* Enable the USARTy Interrupt */
    NVIC_InitStructure.NVIC_IRQChannel = _485_INT_IRQ; 
    NVIC_InitStructure.NVIC_IRQChannelPreemptionPriority =1;
    NVIC_InitStructure.NVIC_IRQChannelSubPriority = 1;
    NVIC_InitStructure.NVIC_IRQChannelCmd = ENABLE;
    NVIC_Init(&NVIC_InitStructure);
}

void Modbus_Mode_Init(void)
{
	GPIO_InitTypeDef GPIO_InitStructure;
	USART_InitTypeDef USART_InitStructure;

	/* config USART clock */
	RCC_AHB1PeriphClockCmd(_485_USART_RX_GPIO_CLK|_485_USART_TX_GPIO_CLK|_485_RE_GPIO_CLK, ENABLE);
	RCC_APB1PeriphClockCmd(_485_USART_CLK, ENABLE); 

	
	  /* Connect PXx to USARTx_Tx*/
  GPIO_PinAFConfig(_485_USART_RX_GPIO_PORT,_485_USART_RX_SOURCE, _485_USART_RX_AF);

  /* Connect PXx to USARTx_Rx*/
  GPIO_PinAFConfig(_485_USART_TX_GPIO_PORT,_485_USART_TX_SOURCE,_485_USART_TX_AF);

	
	/* USART GPIO config */
   /* Configure USART Tx as alternate function push-pull */
  GPIO_InitStructure.GPIO_OType = GPIO_OType_PP;
  GPIO_InitStructure.GPIO_PuPd = GPIO_PuPd_NOPULL;
  GPIO_InitStructure.GPIO_Mode = GPIO_Mode_AF;

  GPIO_InitStructure.GPIO_Pin = _485_USART_TX_PIN  ;
  GPIO_InitStructure.GPIO_Speed = GPIO_Speed_50MHz;
  GPIO_Init(_485_USART_TX_GPIO_PORT, &GPIO_InitStructure);

  /* Configure USART Rx as alternate function  */
  GPIO_InitStructure.GPIO_Mode = GPIO_Mode_AF; 
	GPIO_InitStructure.GPIO_Pin = _485_USART_RX_PIN;
  GPIO_Init(_485_USART_RX_GPIO_PORT, &GPIO_InitStructure);

  
  /* 485收发控制管脚 */
  GPIO_InitStructure.GPIO_OType = GPIO_OType_PP;
  GPIO_InitStructure.GPIO_PuPd = GPIO_PuPd_NOPULL;
  GPIO_InitStructure.GPIO_Mode = GPIO_Mode_OUT;
  GPIO_InitStructure.GPIO_Pin = _485_RE_PIN  ;
  GPIO_InitStructure.GPIO_Speed = GPIO_Speed_50MHz;
  GPIO_Init(_485_RE_GPIO_PORT, &GPIO_InitStructure);
	  
	/* USART mode config */
	USART_InitStructure.USART_BaudRate = _485_USART_BAUDRATE;
	USART_InitStructure.USART_WordLength = USART_WordLength_8b;
	USART_InitStructure.USART_StopBits = USART_StopBits_1;
	USART_InitStructure.USART_Parity = USART_Parity_No ;
	USART_InitStructure.USART_HardwareFlowControl = USART_HardwareFlowControl_None;
	USART_InitStructure.USART_Mode = USART_Mode_Rx | USART_Mode_Tx;

	USART_Init(_485_USART, &USART_InitStructure); 
  USART_Cmd(_485_USART, ENABLE);
	
	NVIC_Configuration();
	/* 使能串口接收中断 */
	USART_ITConfig(_485_USART, USART_IT_RXNE, ENABLE);
	
	GPIO_ResetBits(_485_RE_GPIO_PORT,_485_RE_PIN); //默认进入接收模式
	
}

/********************************************************
  * @brief      : USART1_IRQHandler
  * @details    : 串口1中断服务函数
  * @param [in] : 无
									
  * @param [out]: 无
  * @retval     :0 成功，其它表示错误码
  * History
  * @date       : 2020/12/1
  *	@author     : Nimotion
  * @note       : 
  *
  ********************************************************/
void USART2_IRQHandler(void)
{    
  uint8_t res;
 	if(USART_GetITStatus(USART2, USART_IT_RXNE) != RESET) //接收到数据
	{	 
	 			 
		res =USART_ReceiveData(USART2); 	//读取接收到的数据
		if(RS485_RX_CNT<64)
		{
			RS485_RX_BUF[RS485_RX_CNT]=res;		//记录接收到的值
			RS485_RX_CNT++;						//接收数据增加1 
			TIM_ClearITPendingBit(TIM3,TIM_IT_Update);
			TIM_SetCounter(TIM3,0);
			TIM_Cmd(TIM3,ENABLE);
		} 
		USART_ClearFlag(USART2,USART_FLAG_RXNE);

	}  						
	/* BEGIN:   PN:1 */	
	/* END:   PN:1 */	
}
/********************************************************
  * @brief      : USART_Send_Buffer
  * @details    : 串口发送数据
  * @param [in] : buf 发送数组指针，size 发送数据大小
  * @param [out]: None
  * @retval     :
  * Calls       :
  * Called By   :

  * History
  * @date       : 2019/7/8
  * @author     : Nimotion
  *   @note     : Created function
  *
  ********************************************************/
void USART_Send_Buffer(uint8_t *buf,uint8_t size)
{
	uint8_t t=0;
	GPIO_SetBits(GPIOC,GPIO_Pin_0);
	//GPIO_ResetBits(GPIOB,GPIO_Pin_11);
	for(t=0;t<size;t++)		//循环发送数据
	{		   
		while(USART_GetFlagStatus(USART2, USART_FLAG_TXE) == RESET);	  
		USART_SendData(USART2,buf[t]);
	}	 
 
	while(USART_GetFlagStatus(USART2, USART_FLAG_TC) == RESET);		
	RS485_RX_CNT=0;	 
		//delay_ms(1000);
	GPIO_ResetBits(GPIOC,GPIO_Pin_0);

	/* BEGIN:   PN:1 */	
	/* END:   PN:1 */		
}

/********************************************************
  * @brief      : usMBCRC16
  * @details    : 16位crc校验
  * @param [in] : pucFrame 数组指针，size 数据大小
  * @param [out]: None
  * @retval     :
  * Calls       :
  * Called By   :

  * History
  * @date       : 2019/7/8
  * @author     : Nimotion
  *   @note     : Created function
  *
  ********************************************************/
uint16_t usMBCRC16( uint8_t * pucFrame, uint16_t usLen )
{
    uint8_t           ucCRCHi = 0xFF;
    uint8_t           ucCRCLo = 0xFF;
    int             iIndex;

    while( usLen-- )
    {
        iIndex = ucCRCLo ^ *( pucFrame++ );
        ucCRCLo = ( uint8_t )( ucCRCHi ^ aucCRCHi[iIndex] );
        ucCRCHi = aucCRCLo[iIndex];
    }
    return ( uint16_t )( ucCRCHi << 8 | ucCRCLo );
}



/**** Copyright (C)2018 Nimotion All Rights Reserved **** END OF FILE ****/
